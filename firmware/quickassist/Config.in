## firmware/quickassist/Config.in
```kconfig
menu "Configuration"
	depends on PACKAGE_kmod-crypto-qat

config CRYPTO_QAT_DEBUG
	bool
	default n
	prompt "Build with debugging support enabled"

endmenu
```
